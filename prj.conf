## CMakeLists.txt
```
# SPDX-License-Identifier: Apache-2.0

cmake_minimum_required(VERSION 3.13.1)

find_package(Zephyr REQUIRED HINTS $ENV{ZEPHYR_BASE})
project(kw1281-diag)

target_sources(app PRIVATE src/main.c)
target_sources(app PRIVATE src/kw1281.c)
```

## prj.conf
```kconfig
CONFIG_GPIO=y
CONFIG_SERIAL=y
CONFIG_MAIN_STACK_SIZE=512
CONFIG_SHELL=y
CONFIG_SHELL_PROMPT_UART="kw1281-diag: "
CONFIG_BOOT_BANNER=n
CONFIG_SHELL_STACK_SIZE=4096
CONFIG_USB=y
CONFIG_USB_DEVICE_STACK=y
CONFIG_USB_DEVICE_MANUFACTURER="Jonathan Klamroth <jonathan.klamroth@gmail.com>"
CONFIG_USB_DEVICE_PRODUCT="kw1281-diag"
CONFIG_USB_DEVICE_VID=0x16c0
CONFIG_USB_DEVICE_PID=0x05e1
CONFIG_USB_UART_CONSOLE=y
CONFIG_UART_LINE_CTRL=y
CONFIG_UART_SHELL_ON_DEV_NAME="CDC_ACM_0"
CONFIG_SHELL_BACKEND_SERIAL_INIT_PRIORITY=51
```

## src/kw1281.h
```c
/*
 * Copyright 2021 Jonathan Klamroth
 *
 * Licensed under the Apache License, Version 2.0 (the "License");
 * you may not use this file except in compliance with the License.
 * You may obtain a copy of the License at
 *
 *     http://www.apache.org/licenses/LICENSE-2.0
 *
 * Unless required by applicable law or agreed to in writing, software
 * distributed under the License is distributed on an "AS IS" BASIS,
 * WITHOUT WARRANTIES OR CONDITIONS OF ANY KIND, either express or implied.
 * See the License for the specific language governing permissions and
 * limitations under the License.
 */

#ifndef KW1281_H
#define KW1281_H


#include <stdint.h>
#include <zephyr.h>
#include <drivers/gpio.h>
#include <drivers/uart.h>


#define KW1281_MAX_BLOCK_LEN                    (255)
#define KW1281_MAX_BLOCK_DATA_LEN               (KW1281_MAX_BLOCK_LEN-3)
#define KW1281_BLOCK_END                        (0x03)
#define KW1281_KEY_WORD                         (1281)

#define KW1281_BYTE_COMPLEMENT(x)               (~(x) & 0xFF)
#define KW1281_TIMEOUT(state, id)               ((((uint32_t) ((state)->cfg.timeout_##id)) * ((state)->cfg.timeout_multiplier) + 50) / 100)


#define KW1281_TX_THREAD_STACK_SIZE             (512)


enum kw1281_error {
    KW1281_ERROR_UNKNOWN,
    KW1281_ERROR_NOT_CONNECTED,
    KW1281_ERROR_INVALID_ARGUMENT,
    KW1281_ERROR_CONNECT_TIMEOUT,
    KW1281_ERROR_RECEIVE_BLOCK_TIMEOUT,
    KW1281_ERROR_TRANSMIT_BLOCK_TIMEOUT,
};

enum kw1281_async_error_type {
    KW1281_ASYNC_ERROR_UNKNOWN,
    KW1281_ASYNC_ERROR_COLLISION,
    KW1281_ASYNC_ERROR_CONNECT_NO_SYNC,
    KW1281_ASYNC_ERROR_CONNECT_INVALID_KEY_WORD,
    KW1281_ASYNC_ERROR_UART_CONFIG,
    KW1281_ASYNC_ERROR_RECEIVE_BLOCK_INVALID_LENGTH,
    KW1281_ASYNC_ERROR_RECEIVE_BLOCK_INVALID_COUNTER,
    KW1281_ASYNC_ERROR_TRANSMIT_INVALID_ACK,
    KW1281_ASYNC_ERROR_OVERRUN,
};

enum kw1281_protocol_state {
    KW1281_PROTOCOL_STATE_DISCONNECTED,
    KW1281_PROTOCOL_STATE_DISCONNECT_REQUEST,
    KW1281_PROTOCOL_STATE_CONNECT_ADDR,
    KW1281_PROTOCOL_STATE_CONNECT_SYNC,
    KW1281_PROTOCOL_STATE_CONNECT_KEY_WORD,
    KW1281_PROTOCOL_STATE_RX_LEN,
    KW1281_PROTOCOL_STATE_RX_COUNTER,
    KW1281_PROTOCOL_STATE_RX_TITLE,
    KW1281_PROTOCOL_STATE_RX_DATA,
    KW1281_PROTOCOL_STATE_RX_END,
    KW1281_PROTOCOL_STATE_TX_WAIT,
    KW1281_PROTOCOL_STATE_TX_LEN,
    KW1281_PROTOCOL_STATE_TX_COUNTER,
    KW1281_PROTOCOL_STATE_TX_TITLE,
    KW1281_PROTOCOL_STATE_TX_DATA,
    KW1281_PROTOCOL_STATE_TX_END,
};


struct kw1281_state;
struct kw1281_async_error;

typedef void (*kw1281_async_error_callback_t)(const struct kw1281_state *state, struct kw1281_async_error *async_error);


struct kw1281_async_error {
    enum kw1281_async_error_type type;
};

struct kw1281_block {
    uint8_t length;
    uint8_t counter;
    uint8_t title;
    uint8_t data[KW1281_MAX_BLOCK_DATA_LEN];
};


struct kw1281_config {
    uint16_t baudrate;
    uint8_t auto_baud;
    uint8_t inter_byte_time_ms;                 // time between two bytes on the k line
    uint16_t inter_block_time_ms;
    uint16_t key_word_ack_delay_ms;
    uint16_t timeout_multiplier;

    uint32_t timeout_connect_ms;
    uint32_t timeout_receive_block_ongoing_tx_ms;
    uint32_t timeout_receive_block_rx_start_ms;
    uint32_t timeout_receive_block_rx_ms;
    uint32_t timeout_transmit_block_ongoing_tx_ms;
    uint32_t timeout_transmit_block_tx_ms;

    const struct device *uart_dev;
    const struct device *slow_init_dev;
    int slow_init_pin;
    const struct device *uart_rx_dev;
    int uart_rx_pin;

    const struct device *status_led_dev;
    int status_led_pin;
    int status_led_active_low;
    uint32_t status_led_timeout_ms;

    kw1281_async_error_callback_t async_error_callback;
};

struct kw1281_state {
    // kernel objects
    struct k_mutex mutex;
    struct k_mutex dummy_mutex;
    struct k_condvar condvar_connect;
    struct k_condvar condvar_rx_block;
    struct k_condvar condvar_rx_block_started;
    struct k_condvar condvar_tx_block;
    struct k_work work_timer_slow_init_tx;
    struct k_work work_timer_tx;
    struct k_work work_timer_rx;
    struct k_work work_timer_status_led;
    struct k_work work_rx_auto_baud;
    struct k_timer timer_slow_init_tx;
    struct k_timer timer_tx;
    struct k_timer timer_rx;
    struct k_timer timer_status_led;

    // protocol data
    enum kw1281_protocol_state protocol_state;
    uint16_t key_word;
    uint8_t counter;
    uint8_t counter_valid;

    // rx/tx data
    uint8_t rx_data;
    uint8_t tx_data;
    struct kw1281_block rx_block;
    struct kw1281_block tx_block;

    // auto baud rx
    uint32_t rx_auto_baud_timestamps[10];
    uint8_t rx_auto_baud_counter;

    // internal state
    enum kw1281_error error;
    uint8_t key_word_parity_error;
    uint8_t rx_counter;
    uint8_t tx_counter;
    uint8_t address;
    uint8_t ack;
    uint8_t rx_data_valid;
    uint8_t tx_data_valid;
    uint8_t rx_block_valid;
    uint8_t rx_block_started;
    uint8_t tx_block_valid;
    uint8_t rx_enabled;
    uint8_t rx_auto_baud_enabled;
    uint8_t slow_init_started;

    // control
    uint8_t connect_request;
    uint8_t disconnect_request;

    // device configurations
    struct uart_config uart_cfg;

    // gpio
    struct gpio_callback uart_rx_callback;

    // configuration
    struct kw1281_config cfg;
};


uint8_t kw1281_init(struct kw1281_state *state, const struct kw1281_config *config);
uint8_t kw1281_get_baudrate(struct kw1281_state *state, uint16_t *baudrate);
uint8_t kw1281_set_baudrate(struct kw1281_state *state, uint16_t baudrate);
uint8_t kw1281_get_auto_baud(struct kw1281_state *state, uint8_t *auto_baud);
uint8_t kw1281_set_auto_baud(struct kw1281_state *state, uint8_t auto_baud);
uint8_t kw1281_get_inter_byte_time_ms(struct kw1281_state *state, uint8_t *inter_byte_time_ms);
uint8_t kw1281_set_inter_byte_time_ms(struct kw1281_state *state, uint8_t inter_byte_time_ms);
uint8_t kw1281_get_inter_block_time_ms(struct kw1281_state *state, uint16_t *inter_block_time_ms);
uint8_t kw1281_set_inter_block_time_ms(struct kw1281_state *state, uint16_t inter_block_time_ms);
uint8_t kw1281_get_key_word_ack_delay_ms(struct kw1281_state *state, uint16_t *key_word_ack_delay_ms);
uint8_t kw1281_set_key_word_ack_delay_ms(struct kw1281_state *state, uint16_t key_word_ack_delay_ms);
uint8_t kw1281_get_timeout_multiplier(struct kw1281_state *state, uint16_t *timeout_multiplier);
uint8_t kw1281_set_timeout_multiplier(struct kw1281_state *state, uint16_t timeout_multiplier);
uint8_t kw1281_connect(struct kw1281_state *state, uint8_t addr, uint8_t wait);
uint8_t kw1281_send_block(struct kw1281_state *state, const struct kw1281_block *block, uint8_t wait);
uint8_t kw1281_receive_block(struct kw1281_state *state, struct kw1281_block *block);
void kw1281_disconnect(struct kw1281_state *state);
uint8_t kw1281_is_disconnected(struct kw1281_state *state);
enum kw1281_error kw1281_get_error(struct kw1281_state *state);
const char * kw1281_get_error_msg(struct kw1281_state *state);
const char * kw1281_get_async_error_type_msg(enum kw1281_async_error_type async_error_type);


#endif /* KW1281_H */
```

## src/soft_uart.c
```c
#include <zephyr.h>
#include <drivers/gpio.h>

#include "soft_uart.h"


// TODO
#define SOFT_UART_RX_THREAD_STACK_SIZE              1024
#define SOFT_UART_RX_THREAD_PRIORITY                -5
#define SOFT_UART_TX_THREAD_PRIORITY                -5


// TODO
static struct k_thread soft_uart_rx_thread_data;
static K_THREAD_STACK_DEFINE(soft_uart_rx_thread_stack, SOFT_UART_RX_THREAD_STACK_SIZE);
static k_tid_t soft_uart_rx_thread_id;

static volatile int foo_value = 0;


// gpio callback (falling edge) ->
// - save current cycle count
// - disable interrupt
// - start rx
//
// OR:
//
// gpio callback (both edges) ->
// - save current cycle count to list
// - evaluate received data in thread

static struct soft_uart_config foo_config;

/*
static int soft_uart_rx_bit_counter = 0;
static uint16_t soft_uart_rx_data;
static uint32_t soft_uart_rx_t_start;
static uint32_t soft_uart_rx_buf = 0;

static void soft_uart_rx_gpio_handler (const struct device *dev, struct gpio_callback *cb, uint32_t pins) {
    struct soft_uart_config *config = foo_config;

    uint32_t t = sys_clock_cycle_get_32();
    uint32_t bit_cycles =  sys_clock_hw_cycles_per_sec() / config->baudrate;
    int max_bit_count = 1 + 8 + 1;      // TODO config

    int pin = 0;
    while (pins != 1) {
        pin += 1;
        pins >>= 1;
    }

    int bit = gpio_pin_get_raw(dev, pin);

    if (soft_uart_rx_bit_counter == 0) {
        if (bit == 0) {
            soft_uart_rx_t_start = t;
            // TODO: setup timeout

            soft_uart_rx_data = 0;
            soft_uart_rx_bit_counter++;
        } else {
            // ignore
        }
    } else {
        uint32_t num_bits = (t - soft_uart_rx_t_start + (bit_cycles/2)) / bit_cycles;
        if ((soft_uart_rx_bit_counter + num_bits) <= max_bit_count) {
            soft_uart_rx_data = (0xFFFF << (16-num_bits)) | (soft_uart_rx_data >> num_bits);
            soft_uart_rx_bit_counter += num_bits;

            if (soft_uart_rx_bit_counter == max_bit_count) {
                soft_uart_rx_buf = (1UL<<31) | soft_uart_rx_data;
                soft_uart_rx_bit_counter = 0;
            }
        } else {
            // error -> reset
            soft_uart_rx_bit_counter = 0;
        }
    }
}
*/

static uint32_t soft_uart_rx_t_start;
static volatile uint32_t soft_uart_rx_data = 0;

K_SEM_DEFINE(soft_uart_rx_sem, 0, 1);

static void soft_uart_rx_gpio_handler (const struct device *dev, struct gpio_callback *cb, uint32_t pins) {
    struct soft_uart_config *config = &foo_config;

    foo_value = !foo_value;
    gpio_pin_set_raw(config->dev_gpio_rx, 1, foo_value);

    uint32_t t_start = sys_clock_cycle_get_32();
    uint32_t bit_cycles =  sys_clock_hw_cycles_per_sec() / config->baudrate;

    int bit = gpio_pin_get_raw(config->dev_gpio_rx, config->pin_gpio_rx);
    if (bit == 0) {
        //gpio_pin_interrupt_configure(config->dev_gpio_rx, config->pin_gpio_rx, GPIO_INT_DISABLE);

        uint16_t data = 0;
        int num_bits = 8+1;       // TODO config

        //while((sys_clock_cycle_get_32()-t_start) < bit_cycles/2);
        //t_start += bit_cycles/2;

        foo_value = !foo_value;
        gpio_pin_set_raw(config->dev_gpio_rx, 1, foo_value);

        for (int i=0; i<num_bits; i++) {
            while((sys_clock_cycle_get_32()-t_start) < (i+1)*bit_cycles);

            bit = gpio_pin_get_raw(config->dev_gpio_rx, config->pin_gpio_rx);
            data = (bit << (num_bits-1)) | (data >> 1);

            foo_value = !foo_value;
            gpio_pin_set_raw(config->dev_gpio_rx, 1, foo_value);
        }

        while((sys_clock_cycle_get_32()-t_start) < ((num_bits-1)*bit_cycles + bit_cycles/2));

        soft_uart_rx_data = (1UL<<31) | (data & 0xFF);
        k_sem_give(&soft_uart_rx_sem);
    }
}

static void soft_uart_rx_thread (void *p1, void *p2, void *p3) {
    //struct soft_uart_config *config = p1;
    struct soft_uart_config *config = &foo_config;

    static struct gpio_callback callback;
    gpio_init_callback(&callback, soft_uart_rx_gpio_handler, BIT(config->pin_gpio_rx));
    gpio_add_callback(config->dev_gpio_rx, &callback);

    gpio_pin_interrupt_configure(config->dev_gpio_rx, config->pin_gpio_rx, GPIO_INT_EDGE_BOTH);

    foo_value = !foo_value;
    gpio_pin_set_raw(config->dev_gpio_rx, 1, foo_value);

    for (;;) {
        k_sem_take(&soft_uart_rx_sem, K_FOREVER);

        foo_value = !foo_value;
        gpio_pin_set_raw(config->dev_gpio_rx, 1, foo_value);

        printk("rx: %02x\n", (int) (soft_uart_rx_data & 0xFF));
        soft_uart_rx_data = 0;
    }
}


void soft_uart_init (struct soft_uart_config *config) {
    gpio_pin_configure(config->dev_gpio_tx, config->pin_gpio_tx, GPIO_OUTPUT_HIGH);
    gpio_pin_configure(config->dev_gpio_rx, config->pin_gpio_rx, GPIO_INPUT | GPIO_PULL_UP);

    // debug
    gpio_pin_configure(config->dev_gpio_rx, 1, GPIO_OUTPUT_LOW);
    foo_value = 0;

    foo_config = *config;

    soft_uart_rx_thread_id = k_thread_create(&soft_uart_rx_thread_data,
            soft_uart_rx_thread_stack, K_THREAD_STACK_SIZEOF(soft_uart_rx_thread_stack),
            soft_uart_rx_thread, NULL, NULL, NULL,
            SOFT_UART_RX_THREAD_PRIORITY, 0, K_NO_WAIT);
}


int soft_uart_tx (struct soft_uart_config *config, uint8_t data) {
    uint32_t bit_cycles =  sys_clock_hw_cycles_per_sec() / config->baudrate;

    uint16_t data_with_parity;

    uint8_t num_bits;
    if (config->data_bits == SOFT_UART_DATA_BITS_7) {
        num_bits = 7;
        data_with_parity = data & 0x7F;
    } else if (config->data_bits == SOFT_UART_DATA_BITS_8) {
        num_bits = 8;
        data_with_parity = data & 0xFF;
    } else {
        return SOFT_UART_ERR_CONFIG;
    }

    uint8_t parity;
    if (config->parity == SOFT_UART_PARITY_EVEN) {
        parity = 0;
    } else if (config->parity == SOFT_UART_PARITY_ODD) {
        parity = 1;
    } else if (config->parity != SOFT_UART_PARITY_NONE) {
        return SOFT_UART_ERR_CONFIG;
    }

    // parity bits
    if (config->parity != SOFT_UART_PARITY_NONE) {
        for (int i=0; i<num_bits; i++) {
            if (data & (1<<i)) {
                parity ^= 1;
            }
        }

        if (parity) {
            data_with_parity |= 1<<num_bits;
        }

        num_bits++;
    }

    // start bit
    data_with_parity <<= 1;
    num_bits++;

    // stop bit
    data_with_parity |= 1<<num_bits;
    num_bits++;


    k_tid_t tid = k_current_get();
    int old_priority = k_thread_priority_get(tid);

    // temporarily increase priority
    k_thread_priority_set(tid, SOFT_UART_TX_THREAD_PRIORITY);

    uint32_t t_start = k_cycle_get_32();

    // transmit bits
    for (int i=0; i<num_bits; i++) {
        int bit = data_with_parity & 1;
        gpio_pin_set_raw(config->dev_gpio_tx, config->pin_gpio_tx, bit);

        data_with_parity >>= 1;

        // skip equal bits
        while (i < (num_bits-1) && (data_with_parity & 1) == bit) {
            i++;
            data_with_parity >>= 1;
        }

        SOFT_UART_DELAY_UNTIL(t_start, (i+1)*bit_cycles);
    }

    k_thread_priority_set(tid, old_priority);


    return SOFT_UART_OK;
}

int soft_uart_rx (struct soft_uart_config *config, uint8_t *data, uint32_t timeout_ms) {
    uint32_t t_timeout_start = k_cycle_get_32();
    uint32_t timeout_cycles = sys_clock_hw_cycles_per_sec() / 1000 * timeout_ms;

    uint32_t bit_cycles =  sys_clock_hw_cycles_per_sec() / config->baudrate;

    uint16_t data_with_parity = 0;

    uint8_t num_bits;
    if (config->data_bits == SOFT_UART_DATA_BITS_7) {
        num_bits = 7;
    } else if (config->data_bits == SOFT_UART_DATA_BITS_8) {
        num_bits = 8;
    } else {
        return SOFT_UART_ERR_CONFIG;
    }

    uint8_t parity = 0;
    if (config->parity == SOFT_UART_PARITY_EVEN) {
        parity = 0;
        num_bits++;
    } else if (config->parity == SOFT_UART_PARITY_ODD) {
        parity = 1;
        num_bits++;
    } else if (config->parity != SOFT_UART_PARITY_NONE) {
        return SOFT_UART_ERR_CONFIG;
    }

    while (timeout_ms == 0 || (k_cycle_get_32()-t_timeout_start) < timeout_cycles) {
        if (gpio_pin_get_raw(config->dev_gpio_rx, config->pin_gpio_rx)) {
            continue;
        }

        uint32_t t_start = k_cycle_get_32();
        SOFT_UART_DELAY_UNTIL(t_start, bit_cycles/4);
        t_start += bit_cycles/4;

        for (int i=0; i<(num_bits+2); i++) {
            int bit = gpio_pin_get_raw(config->dev_gpio_rx, config->pin_gpio_rx);
            if (i == 0) {
                if (bit != 0) {
                    return SOFT_UART_ERR_FRAME;
                }
            } else if (i == num_bits+1) {
                if (bit != 1) {
                    return SOFT_UART_ERR_FRAME;
                }
            } else {
                data_with_parity >>= 1;
                data_with_parity |= bit<<(num_bits-1);

                if (bit) {
                    parity ^= 1;
                }
            }

            SOFT_UART_DELAY_UNTIL(t_start, (i+1)*bit_cycles);
        }

        if (config->parity != SOFT_UART_PARITY_NONE) {
            if (parity != 0) {
                return SOFT_UART_ERR_PARITY;
            }

            *data = data_with_parity & ~(1<<(num_bits-1));
        } else {
            *data = data_with_parity;
        }

        return SOFT_UART_OK;
    }

    return SOFT_UART_ERR_TIMEOUT;
}

// TODO
int soft_uart_sync (struct soft_uart_config *config, uint32_t timeout_ms) {
    uint32_t t_timeout_start = k_cycle_get_32();
    uint32_t timeout_cycles = sys_clock_hw_cycles_per_sec() / 1000 * timeout_ms;

    uint32_t bit_time_deltas[9];
    uint32_t t_now;
    uint32_t t_bit_start = 0;
    uint8_t state = 0;
    uint8_t wait_for_level = 0;

    while (timeout_ms == 0 || (k_cycle_get_32()-t_timeout_start) < timeout_cycles) {
        if (gpio_pin_get_raw(config->dev_gpio_rx, config->pin_gpio_rx) != wait_for_level) {
            continue;
        }

        t_now = k_cycle_get_32();

        if (state > 0) {
            bit_time_deltas[state-1] = t_now - t_bit_start;
            if (state == 9) {
                uint32_t sum = 0;
                for (int i=0; i<9; i++) {
                    sum += bit_time_deltas[i];
                }

                uint32_t avg = sum/9;

                for (int i=0; i<9; i++) {
                    int32_t deviation = ((int32_t) bit_time_deltas[i]) - ((int32_t) avg);
                    deviation = deviation > 0 ? deviation : -deviation;

                    // allow a deviation of 25% from the avergae
                    if (deviation > avg/4) {
                        return SOFT_UART_ERR_TIMING;
                    }
                }

                config->baudrate = ((sys_clock_hw_cycles_per_sec()*2 / avg) + 1)/2;

                return SOFT_UART_OK;
            }

            // 0x55 =  01010101
            // 11111 0 10101010 1 11111
            //       |          |
            // start (inc)      end (excl)
            // -> 9 bits
        }

        wait_for_level = !wait_for_level;

        t_bit_start = t_now;
        state++;
    }

    return SOFT_UART_ERR_TIMEOUT;
}
```

## src/soft_uart.h
```c
#ifndef SOFT_UART_H
#define SOFT_UART_H


#include <stdint.h>
#include <device.h>


#define SOFT_UART_SLEEP_TICKS_THRESHOLD                 (3)

#define SOFT_UART_DELAY_UNTIL(t_start, delay)                                       \
    do {                                                                            \
        uint32_t elapsed_cycles = (k_cycle_get_32()-(t_start));                     \
        if ((delay) > elapsed_cycles) {                                             \
            uint32_t remaining_ticks = ((uint64_t) ((delay)-elapsed_cycles)) *      \
                CONFIG_SYS_CLOCK_TICKS_PER_SEC / sys_clock_hw_cycles_per_sec();     \
            if (remaining_ticks >= SOFT_UART_SLEEP_TICKS_THRESHOLD) {               \
                k_timeout_t timeout = {                                             \
                    .ticks = remaining_ticks-1                                      \
                };                                                                  \
                k_sleep(timeout);                                                   \
            }                                                                       \
        }                                                                           \
        while((k_cycle_get_32()-(t_start)) < (delay));                              \
    } while (0)



#define SOFT_UART_OK                    (0)
#define SOFT_UART_ERR_TIMEOUT           (-1)
#define SOFT_UART_ERR_FRAME             (-2)
#define SOFT_UART_ERR_TIMING            (-3)
#define SOFT_UART_ERR_CONFIG            (-4)
#define SOFT_UART_ERR_PARITY            (-5)

#define SOFT_UART_PARITY_NONE           (0)
#define SOFT_UART_PARITY_EVEN           (1)
#define SOFT_UART_PARITY_ODD            (2)

#define SOFT_UART_DATA_BITS_7           (0)
#define SOFT_UART_DATA_BITS_8           (1)


struct soft_uart_config {
    const struct device *dev_gpio_tx;
    int pin_gpio_tx;

    const struct device *dev_gpio_rx;
    int pin_gpio_rx;

    uint32_t baudrate;
    uint8_t parity;
    uint8_t data_bits;
};


void soft_uart_init(struct soft_uart_config *config);

int soft_uart_tx(struct soft_uart_config *config, uint8_t data);
int soft_uart_rx(struct soft_uart_config *config, uint8_t *data, uint32_t timeout_ms);
int soft_uart_sync(struct soft_uart_config *config, uint32_t timeout_ms);


#endif /* SOFT_UART_H */
```
